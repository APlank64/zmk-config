## boards/shields/Kconfig.defconfig
```kconfig
if SHIELD_MY_KEYBOARD_LEFT

# Name must be less than 16 characters long!
config ZMK_KEYBOARD_NAME
    default "My_Keyboard"

config SPI
    default y

endif
```

## boards/shields/planke/Kconfig.defconfig
```kconfig
if SHIELD_PLANKE

# Name must be less than 16 characters long!
config ZMK_KEYBOARD_NAME
    default "planke"

config SPI
    default y

endif
```

## boards/shields/planke/Kconfig.shield
```kconfig
# No whitespace after the comma or in your part name!
config SHIELD_PLANKE
    def_bool $(shields_list_contains,planke)
    select SPI
```
